# file: E-Load Controller - Large.ioc
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ADC1.Channel-0\#ChannelRegularConversion=ADC_CHANNEL_0
ADC1.ClockPrescaler=ADC_CLOCK_SYNC_PCLK_DIV4
ADC1.NbrOfConversionFlag=1
ADC1.Rank-0\#ChannelRegularConversion=1
ADC1.SamplingTime-0\#ChannelRegularConversion=ADC_SAMPLETIME_3CYCLES
ADC1.master=1
ADC2.Channel-0\#ChannelRegularConversion=ADC_CHANNEL_0
ADC2.ClockPrescaler=ADC_CLOCK_SYNC_PCLK_DIV4
ADC2.NbrOfConversionFlag=1
ADC2.Rank-0\#ChannelRegularConversion=1
ADC2.SamplingTime-0\#ChannelRegularConversion=ADC_SAMPLETIME_3CYCLES
ADC3.Channel-0\#ChannelRegularConversion=ADC_CHANNEL_0
ADC3.ClockPrescaler=ADC_CLOCK_SYNC_PCLK_DIV4
ADC3.NbrOfConversionFlag=1
ADC3.Rank-0\#ChannelRegularConversion=1
ADC3.SamplingTime-0\#ChannelRegularConversion=ADC_SAMPLETIME_3CYCLES
Mcu.Family=STM32F4
Mcu.Name=STM32F429B(E-G-I)Tx
Mcu.Package=LQFP208
NVIC.PriorityGroup=NVIC_PRIORITYGROUP_4
PA0/WKUP.GPIO_Label=REMOTE_VSENSE
PA0/WKUP.Signal=ADCx_IN0
PA1.GPIO_Label=I_SUM
PA1.Signal=ADCx_IN1
PA11.Mode=Device_Only
PA11.Signal=USB_OTG_FS_DM
PA12.Mode=Device_Only
PA12.Signal=USB_OTG_FS_DP
PA13.Mode=Trace_Asynchronous_SW
PA13.Signal=SYS_JTMS-SWDIO
PA14.Mode=Trace_Asynchronous_SW
PA14.Signal=SYS_JTCK-SWCLK
PA2.GPIO_Label=IMUX_OUT7
PA2.Signal=ADCx_IN2
PA3.GPIO_Label=IMUX_OUT4
PA3.Signal=ADCx_IN3
PA4.GPIO_Label=TC_MUX
PA4.Signal=ADCx_IN4
PA5.GPIO_Label=THERMISTOR_MUX
PA5.Signal=ADCx_IN5
PA6.GPIO_Label=IMUX_OUT1
PA6.Signal=ADCx_IN6
PA7.GPIO_Label=IMUX_OUT0
PA7.Signal=ADCx_IN7
PB0.GPIO_Label=IMUX_OUT2
PB0.Signal=ADCx_IN8
PB1.GPIO_Label=IMUX_OUT3
PB1.Signal=ADCx_IN9
PB10.GPIO_Label=TFT_SCLK
PB10.Mode=Full_Duplex_Master
PB10.Signal=SPI2_SCK
PB11.GPIO_Label=IO1
PB11.Signal=GPIO_Output
PB12.GPIO_Label=TFT_CS
PB12.Mode=NSS_Signal_Hard_Output
PB12.Signal=SPI2_NSS
PB13.GPIO_Label=IO2
PB13.Signal=GPIO_Output
PB14.GPIO_Label=SD_MISO
PB14.Mode=Full_Duplex_Master
PB14.Signal=SPI2_MISO
PB15.GPIO_Label=TFT_MOSI
PB15.Mode=Full_Duplex_Master
PB15.Signal=SPI2_MOSI
PB3.Mode=Trace_Asynchronous_SW
PB3.Signal=SYS_JTDO-SWO
PB4.GPIO_Label=TFT_RESET
PB4.Signal=GPIO_Output
PB5.GPIO_Label=TFT_DC
PB5.Signal=GPIO_Output
PB6.GPIO_Label=SD_CS
PB6.Signal=GPIO_Output
PB7.GPIO_Label=LED1
PB7.Signal=GPIO_Output
PB8.GPIO_Label=LED2
PB8.Signal=GPIO_Output
PB9.GPIO_Label=FAN_PWM
PB9.Signal=S_TIM11_CH1
PC0.GPIO_Label=IMUX_OUT15
PC0.Signal=ADCx_IN10
PC1.GPIO_Label=IMUX_OUT9
PC1.Signal=ADCx_IN11
PC10.GPIO_Label=SW3
PC10.Signal=GPIO_Input
PC11.GPIO_Label=ENC_SW
PC11.Signal=GPIO_Input
PC12.GPIO_Label=REVERSE_VOLTAGE_ALERT
PC12.Signal=GPIO_Input
PC2.GPIO_Label=IMUX_OUT8
PC2.Signal=ADCx_IN12
PC3.GPIO_Label=IMUX_OUT6
PC3.Signal=ADCx_IN13
PC4.GPIO_Label=IMUX_OUT5
PC4.Signal=ADCx_IN14
PC6.GPIO_Label=ENC_A
PC6.Signal=S_TIM3_CH1
PC7.GPIO_Label=ENC_B
PC7.Signal=S_TIM3_CH2
PC8.GPIO_Label=SW1
PC8.Signal=GPIO_Input
PC9.GPIO_Label=SW2
PC9.Signal=GPIO_Input
PD0.GPIO_Label=FET_EN24
PD0.Signal=GPIO_Output
PD1.GPIO_Label=FET_EN63
PD1.Signal=GPIO_Output
PD10.GPIO_Label=FET_EN9
PD10.Signal=GPIO_Output
PD11.GPIO_Label=FET_EN8
PD11.Signal=GPIO_Output
PD12.GPIO_Label=FET_EN23
PD12.Signal=GPIO_Output
PD13.GPIO_Label=FET_EN22
PD13.Signal=GPIO_Output
PD14.GPIO_Label=FET_EN21
PD14.Signal=GPIO_Output
PD15.GPIO_Label=FET_EN20
PD15.Signal=GPIO_Output
PD2.GPIO_Label=FET_EN62
PD2.Signal=GPIO_Output
PD3.GPIO_Label=FET_EN61
PD3.Signal=GPIO_Output
PD4.GPIO_Label=FET_EN60
PD4.Signal=GPIO_Output
PD5.GPIO_Label=FET_EN59
PD5.Signal=GPIO_Output
PD6.GPIO_Label=FET_EN58
PD6.Signal=GPIO_Output
PD7.GPIO_Label=FET_EN57
PD7.Signal=GPIO_Output
PD8.GPIO_Label=FET_EN11
PD8.Signal=GPIO_Output
PD9.GPIO_Label=FET_EN10
PD9.Signal=GPIO_Output
PE0.GPIO_Label=FET_EN48
PE0.Signal=GPIO_Output
PE1.GPIO_Label=FET_EN47
PE1.Signal=GPIO_Output
PE10.GPIO_Label=FET_EN1
PE10.Signal=GPIO_Output
PE11.GPIO_Label=FET_EN0
PE11.Signal=GPIO_Output
PE12.GPIO_Label=FET_EN15
PE12.Signal=GPIO_Output
PE13.GPIO_Label=FET_EN14
PE13.Signal=GPIO_Output
PE14.GPIO_Label=FET_EN13
PE14.Signal=GPIO_Output
PE15.GPIO_Label=FET_EN12
PE15.Signal=GPIO_Output
PE2.GPIO_Label=FET_EN42
PE2.Signal=GPIO_Output
PE3.GPIO_Label=FET_EN41
PE3.Signal=GPIO_Output
PE4.GPIO_Label=FET_EN40
PE4.Signal=GPIO_Output
PE5.GPIO_Label=FET_EN39
PE5.Signal=GPIO_Output
PE6.GPIO_Label=FET_EN38
PE6.Signal=GPIO_Output
PE7.GPIO_Label=FET_EN4
PE7.Signal=GPIO_Output
PE8.GPIO_Label=FET_EN3
PE8.Signal=GPIO_Output
PE9.GPIO_Label=FET_EN2
PE9.Signal=GPIO_Output
PF3.GPIO_Label=IMUX_OUT11
PF3.Mode=IN9
PF3.Signal=ADC3_IN9
PF4.GPIO_Label=IMUX_OUT10
PF4.Mode=IN14
PF4.Signal=ADC3_IN14
PF5.GPIO_Label=IMUX_OUT12
PF5.Mode=IN15
PF5.Signal=ADC3_IN15
PF6.GPIO_Label=IMUX_OUT13
PF6.Mode=IN4
PF6.Signal=ADC3_IN4
PF7.GPIO_Label=IMUX_OUT14
PF7.Mode=IN5
PF7.Signal=ADC3_IN5
PG0.GPIO_Label=FET_EN6
PG0.Signal=GPIO_Output
PG1.GPIO_Label=FET_EN5
PG1.Signal=GPIO_Output
PG10.GPIO_Label=FET_EN55
PG10.Signal=GPIO_Output
PG11.GPIO_Label=FET_EN54
PG11.Signal=GPIO_Output
PG12.GPIO_Label=FET_EN53
PG12.Signal=GPIO_Output
PG13.GPIO_Label=FET_EN52
PG13.Signal=GPIO_Output
PG14.GPIO_Label=FET_EN51
PG14.Signal=GPIO_Output
PG15.GPIO_Label=FET_EN49
PG15.Signal=GPIO_Output
PG2.GPIO_Label=FET_EN19
PG2.Signal=GPIO_Output
PG3.GPIO_Label=FET_EN18
PG3.Signal=GPIO_Output
PG4.GPIO_Label=FET_EN17
PG4.Signal=GPIO_Output
PG5.GPIO_Label=FET_EN16
PG5.Signal=GPIO_Output
PG6.GPIO_Label=FET_EN31
PG6.Signal=GPIO_Output
PG7.GPIO_Label=FET_EN30
PG7.Signal=GPIO_Output
PG8.GPIO_Label=FET_EN29
PG8.Signal=GPIO_Output
PG9.GPIO_Label=FET_EN56
PG9.Signal=GPIO_Output
PH0/OSC_IN.Mode=HSE-External-Oscillator
PH0/OSC_IN.Signal=RCC_OSC_IN
PH1/OSC_OUT.Mode=HSE-External-Oscillator
PH1/OSC_OUT.Signal=RCC_OSC_OUT
PH11.GPIO_Label=TMUX_S0
PH11.Signal=GPIO_Output
PH12.GPIO_Label=TMUX_S1
PH12.Signal=GPIO_Output
PH13.GPIO_Label=IMUX_S0
PH13.Signal=GPIO_Output
PH14.GPIO_Label=IMUX_S1
PH14.Signal=GPIO_Output
PI0.GPIO_Label=FET_EN28
PI0.Signal=GPIO_Output
PI1.GPIO_Label=FET_EN27
PI1.Signal=GPIO_Output
PI10.GPIO_Label=FET_EN36
PI10.Signal=GPIO_Output
PI11.GPIO_Label=FET_EN35
PI11.Signal=GPIO_Output
PI12.GPIO_Label=FET_EN34
PI12.Signal=GPIO_Output
PI13.GPIO_Label=FET_EN33
PI13.Signal=GPIO_Output
PI14.GPIO_Label=FET_EN32
PI14.Signal=GPIO_Output
PI15.GPIO_Label=FET_EN7
PI15.Signal=GPIO_Output
PI2.GPIO_Label=FET_EN26
PI2.Signal=GPIO_Output
PI3.GPIO_Label=FET_EN25
PI3.Signal=GPIO_Output
PI4.GPIO_Label=FET_EN46
PI4.Signal=GPIO_Output
PI5.GPIO_Label=FET_EN45
PI5.Signal=GPIO_Output
PI6.GPIO_Label=FET_EN44
PI6.Signal=GPIO_Output
PI7.GPIO_Label=FET_EN43
PI7.Signal=GPIO_Output
PI9.GPIO_Label=FET_EN37
PI9.Signal=GPIO_Output
PJ0.GPIO_Label=TMUX_INH0
PJ0.PinState=GPIO_PIN_SET
PJ0.Signal=GPIO_Output
PJ1.GPIO_Label=TMUX_INH1
PJ1.PinState=GPIO_PIN_SET
PJ1.Signal=GPIO_Output
PJ10.GPIO_Label=TMUX_INH10
PJ10.PinState=GPIO_PIN_SET
PJ10.Signal=GPIO_Output
PJ11.GPIO_Label=TMUX_INH11
PJ11.PinState=GPIO_PIN_SET
PJ11.Signal=GPIO_Output
PJ12.GPIO_Label=TMUX_INH12
PJ12.PinState=GPIO_PIN_SET
PJ12.Signal=GPIO_Output
PJ13.GPIO_Label=TMUX_INH13
PJ13.PinState=GPIO_PIN_SET
PJ13.Signal=GPIO_Output
PJ14.GPIO_Label=TMUX_INH14
PJ14.PinState=GPIO_PIN_SET
PJ14.Signal=GPIO_Output
PJ15.GPIO_Label=TMUX_INH15
PJ15.PinState=GPIO_PIN_SET
PJ15.Signal=GPIO_Output
PJ2.GPIO_Label=TMUX_INH2
PJ2.PinState=GPIO_PIN_SET
PJ2.Signal=GPIO_Output
PJ3.GPIO_Label=TMUX_INH3
PJ3.PinState=GPIO_PIN_SET
PJ3.Signal=GPIO_Output
PJ4.GPIO_Label=TMUX_INH4
PJ4.PinState=GPIO_PIN_SET
PJ4.Signal=GPIO_Output
PJ5.GPIO_Label=TMUX_INH5
PJ5.PinState=GPIO_PIN_SET
PJ5.Signal=GPIO_Output
PJ6.GPIO_Label=TMUX_INH6
PJ6.PinState=GPIO_PIN_SET
PJ6.Signal=GPIO_Output
PJ7.GPIO_Label=TMUX_INH7
PJ7.PinState=GPIO_PIN_SET
PJ7.Signal=GPIO_Output
PJ8.GPIO_Label=TMUX_INH8
PJ8.PinState=GPIO_PIN_SET
PJ8.Signal=GPIO_Output
PJ9.GPIO_Label=TMUX_INH9
PJ9.PinState=GPIO_PIN_SET
PJ9.Signal=GPIO_Output
PK7.GPIO_Label=FET_EN50
PK7.Signal=GPIO_Output
ProjectManager.HeapSize=0x200
ProjectManager.StackSize=0x400
ProjectManager.TargetToolchain=STM32CubeIDE
RCC.48MHZClocksFreq_Value=48000000
RCC.AHBFreq_Value=168000000
RCC.APB1CLKDivider=RCC_HCLK_DIV4
RCC.APB1Freq_Value=42000000
RCC.APB1TimFreq_Value=84000000
RCC.APB2CLKDivider=RCC_HCLK_DIV2
RCC.APB2Freq_Value=84000000
RCC.APB2TimFreq_Value=168000000
RCC.CortexFreq_Value=168000000
RCC.HCLKFreq_Value=168000000
RCC.HSE_VALUE=8000000
RCC.HSI_VALUE=16000000
RCC.LSE_VALUE=32768
RCC.PLLM=4
RCC.PLLN=168
RCC.PLLQ=7
RCC.SYSCLKFreq_VALUE=168000000
RCC.SYSCLKSource=RCC_SYSCLKSOURCE_PLLCLK
RCC.VCOOutputFreq_Value=336000000
SH.ADCx_IN0.0=ADC1_IN0,IN0
SH.ADCx_IN0.1=ADC2_IN0,IN0
SH.ADCx_IN0.2=ADC3_IN0,IN0
SH.ADCx_IN1.0=ADC1_IN1,IN1
SH.ADCx_IN1.1=ADC2_IN1,IN1
SH.ADCx_IN1.2=ADC3_IN1,IN1
SH.ADCx_IN10.0=ADC1_IN10,IN10
SH.ADCx_IN10.1=ADC2_IN10,IN10
SH.ADCx_IN10.2=ADC3_IN10,IN10
SH.ADCx_IN11.0=ADC1_IN11,IN11
SH.ADCx_IN11.1=ADC2_IN11,IN11
SH.ADCx_IN11.2=ADC3_IN11,IN11
SH.ADCx_IN12.0=ADC1_IN12,IN12
SH.ADCx_IN12.1=ADC2_IN12,IN12
SH.ADCx_IN12.2=ADC3_IN12,IN12
SH.ADCx_IN13.0=ADC1_IN13,IN13
SH.ADCx_IN13.1=ADC2_IN13,IN13
SH.ADCx_IN13.2=ADC3_IN13,IN13
SH.ADCx_IN14.0=ADC1_IN14,IN14
SH.ADCx_IN14.1=ADC2_IN14,IN14
SH.ADCx_IN2.0=ADC1_IN2,IN2
SH.ADCx_IN2.1=ADC2_IN2,IN2
SH.ADCx_IN2.2=ADC3_IN2,IN2
SH.ADCx_IN3.0=ADC1_IN3,IN3
SH.ADCx_IN3.1=ADC2_IN3,IN3
SH.ADCx_IN3.2=ADC3_IN3,IN3
SH.ADCx_IN4.0=ADC1_IN4,IN4
SH.ADCx_IN4.1=ADC2_IN4,IN4
SH.ADCx_IN5.0=ADC1_IN5,IN5
SH.ADCx_IN5.1=ADC2_IN5,IN5
SH.ADCx_IN6.0=ADC1_IN6,IN6
SH.ADCx_IN6.1=ADC2_IN6,IN6
SH.ADCx_IN7.0=ADC1_IN7,IN7
SH.ADCx_IN7.1=ADC2_IN7,IN7
SH.ADCx_IN8.0=ADC1_IN8,IN8
SH.ADCx_IN8.1=ADC2_IN8,IN8
SH.ADCx_IN9.0=ADC1_IN9,IN9
SH.ADCx_IN9.1=ADC2_IN9,IN9
SH.S_TIM11_CH1.0=TIM11_CH1,PWM Generation1 CH1
SH.S_TIM3_CH1.0=TIM3_CH1,Encoder_Interface
SH.S_TIM3_CH2.0=TIM3_CH2,Encoder_Interface
SPI2.BaudRatePrescaler=SPI_BAUDRATEPRESCALER_2
SPI2.CalculateBaudRate=21.0 MBits/s
SPI2.Direction=SPI_DIRECTION_2LINES
SPI2.Mode=SPI_MODE_MASTER
SPI2.VirtualNSS=VM_NSSHARD
SPI2.VirtualType=VM_MASTER
TIM11.Channel=TIM_CHANNEL_1
TIM11.OCMode_PWM=TIM_OCMODE_PWM2
TIM11.Period=999
TIM11.Prescaler=1679
TIM11.Pulse=300
USB_OTG_FS.VirtualMode=Device_Only
VP_TIM11_VS_ClockSourceINT.Mode=Enable_Timer
board=custom

// file: Core/Src/main.c
/* USER CODE BEGIN Header */
/**
  ******************************************************************************
  * @file           : main.c
  * @brief          : Main program body
  ******************************************************************************
  * @attention
  *
  * Copyright (c) 2023 STMicroelectronics.
  * All rights reserved.
  *
  * This software is licensed under terms that can be found in the LICENSE file
  * in the root directory of this software component.
  * If no LICENSE file comes with this software, it is provided AS-IS.
  *
  ******************************************************************************
  */
/* USER CODE END Header */
#include "main.h"

/* USER CODE BEGIN Includes */

#include <stdio.h>
#include <stdbool.h>

#include "state.h"
#include "display.h"
#include "adc.h"
#include "load.h"
#include "temp.h"

/* USER CODE END Includes */

ADC_HandleTypeDef hadc1;
ADC_HandleTypeDef hadc2;
ADC_HandleTypeDef hadc3;

SPI_HandleTypeDef hspi2;

TIM_HandleTypeDef htim3;
TIM_HandleTypeDef htim11;

PCD_HandleTypeDef hpcd_USB_OTG_FS;

/* USER CODE BEGIN PV */

//Notes:
// TIM3 - Encoder
// TIM11 - Fan PWM
// TIM4 - ADC read during calibration pulse, could be re-used elsewhere

/* USER CODE END PV */

void SystemClock_Config(void);
static void MX_GPIO_Init(void);
static void MX_USB_OTG_FS_PCD_Init(void);
static void MX_ADC1_Init(void);
static void MX_ADC2_Init(void);
static void MX_ADC3_Init(void);
static void MX_SPI2_Init(void);
static void MX_TIM3_Init(void);
static void MX_TIM11_Init(void);

/* USER CODE BEGIN 0 */

//Allows printf to print to SWO
int __io_putchar(int ch)
{
 // Write character to ITM ch.0
 ITM_SendChar(ch);
 return(ch);
}

void IO1_blink(void){
	HAL_GPIO_TogglePin(LED1_GPIO_Port, LED1_Pin);
	HAL_GPIO_TogglePin(IO1_GPIO_Port, IO1_Pin);
}

void IO2_blink(void){
	HAL_GPIO_TogglePin(LED2_GPIO_Port, LED2_Pin);
	HAL_GPIO_TogglePin(IO2_GPIO_Port, IO2_Pin);
}

void Stage_Sequence_Test(void){

	for (int i = 0; i < NUM_STAGES; i++){
		const LoadStageConfiguration* stage = GetPointerToSingleStageConfig(i);
		HAL_GPIO_WritePin(stage->io_port, stage->io_pin, 1);
		HAL_Delay(100);
	}

	HAL_Delay(5000);

	for (int i = 0; i < NUM_STAGES; i++){
		const LoadStageConfiguration* stage = GetPointerToSingleStageConfig(i);
		HAL_GPIO_WritePin(stage->io_port, stage->io_pin, 0);
		HAL_Delay(100);
	}

	HAL_Delay(5000);
}

typedef struct {
	bool enabled;
	uint32_t period_ms;
	uint32_t last_run_time;
	void (*RunTask)(void);
} Task;

void TaskScheduler(Task *task_list, uint32_t number_of_tasks){
	for (int i = 0; i < number_of_tasks; i++){
		uint32_t current_time = HAL_GetTick();
		if (task_list[i].enabled == true
			&& (current_time - task_list[i].last_run_time) >= task_list[i].period_ms
			&& task_list[i].RunTask != 0	//make sure task function pointer isn't null
			&& task_list[i].period_ms != 0	//and period isn't null either
		){
			task_list[i].last_run_time = current_time;
			task_list[i].RunTask();
		}
	}
}

/* USER CODE END 0 */

int main(void)
{

  /* MCU Configuration--------------------------------------------------------*/

  /* Reset of all peripherals, Initializes the Flash interface and the Systick. */
  HAL_Init();

  /* Configure the system clock */
  SystemClock_Config();

  /* Initialize all configured peripherals */
  MX_GPIO_Init();
  MX_USB_OTG_FS_PCD_Init();
  MX_ADC1_Init();
  MX_ADC2_Init();
  MX_ADC3_Init();
  MX_SPI2_Init();
  MX_TIM3_Init();
  MX_TIM11_Init();
  /* USER CODE BEGIN 2 */

  HAL_TIM_Encoder_Start(&ROTARY_ENCODER_TIM, TIM_CHANNEL_ALL);

  ADCInit();

  //start PWM fan control
  //default fan speed is 30%
  HAL_TIM_PWM_Start(&htim11, TIM_CHANNEL_1);

  //start debug cycle counter
  CoreDebug->DEMCR |= CoreDebug_DEMCR_TRCENA_Msk;
  DWT->CTRL |= DWT_CTRL_CYCCNTENA_Msk;

  //Stop TIM4 during break while debugging
  DBGMCU->APB1FZ |= DBGMCU_APB1_FZ_DBG_TIM4_STOP;
  DBGMCU->APB1FZ |= DBGMCU_APB1_FZ_DBG_TIM2_STOP;

#define NUM_TASKS 10
const uint32_t number_of_tasks = NUM_TASKS;
Task task_list[NUM_TASKS] = {0};

//task_list[0].RunTask = IO1_blink;
//task_list[0].period_ms = 500;
//task_list[0].enabled = true;

DisplayInit();
task_list[1].RunTask = DisplayUpdate;
task_list[1].period_ms = 50;
task_list[1].enabled = true;

task_list[2].RunTask = LoadControl;
task_list[2].period_ms = 50;
task_list[2].enabled = true;

task_list[3].RunTask = UpdateLoadStageTemps;
task_list[3].period_ms = 500;
task_list[3].enabled = true;

task_list[4].RunTask = FanSpeedControl;
task_list[4].period_ms = 500;
task_list[4].enabled = true;

task_list[5].RunTask = IO1_blink;
task_list[5].period_ms = 500;
task_list[5].enabled = false;

  /* USER CODE END 2 */

  /* Infinite loop */
  while (1)
  {

    /* USER CODE BEGIN 3 */
	  TaskScheduler(task_list, number_of_tasks);

  }
  /* USER CODE END 3 */
}

void SystemClock_Config(void)
{
  RCC_OscInitTypeDef RCC_OscInitStruct = {0};
  RCC_ClkInitTypeDef RCC_ClkInitStruct = {0};

  /** Configure the main internal regulator output voltage
  */
  __HAL_RCC_PWR_CLK_ENABLE();
  __HAL_PWR_VOLTAGESCALING_CONFIG(PWR_REGULATOR_VOLTAGE_SCALE1);

  /** Initializes the RCC Oscillators according to the specified parameters
  * in the RCC_OscInitTypeDef structure.
  */
  RCC_OscInitStruct.OscillatorType = RCC_OSCILLATORTYPE_HSE;
  RCC_OscInitStruct.HSEState = RCC_HSE_ON;
  RCC_OscInitStruct.PLL.PLLState = RCC_PLL_ON;
  RCC_OscInitStruct.PLL.PLLSource = RCC_PLLSOURCE_HSE;
  RCC_OscInitStruct.PLL.PLLM = 4;
  RCC_OscInitStruct.PLL.PLLN = 168;
  RCC_OscInitStruct.PLL.PLLP = RCC_PLLP_DIV2;
  RCC_OscInitStruct.PLL.PLLQ = 7;
  if (HAL_RCC_OscConfig(&RCC_OscInitStruct) != HAL_OK)
  {
    Error_Handler();
  }

  /** Initializes the CPU, AHB and APB buses clocks
  */
  RCC_ClkInitStruct.ClockType = RCC_CLOCKTYPE_HCLK|RCC_CLOCKTYPE_SYSCLK
                              |RCC_CLOCKTYPE_PCLK1|RCC_CLOCKTYPE_PCLK2;
  RCC_ClkInitStruct.SYSCLKSource = RCC_SYSCLKSOURCE_PLLCLK;
  RCC_ClkInitStruct.AHBCLKDivider = RCC_SYSCLK_DIV1;
  RCC_ClkInitStruct.APB1CLKDivider = RCC_HCLK_DIV4;
  RCC_ClkInitStruct.APB2CLKDivider = RCC_HCLK_DIV2;

  if (HAL_RCC_ClockConfig(&RCC_ClkInitStruct, FLASH_LATENCY_5) != HAL_OK)
  {
    Error_Handler();
  }
}

static void MX_ADC1_Init(void)
{

  ADC_ChannelConfTypeDef sConfig = {0};

  /** Configure the global features of the ADC (Clock, Resolution, Data Alignment and number of conversion)
  */
  hadc1.Instance = ADC1;
  hadc1.Init.ClockPrescaler = ADC_CLOCK_SYNC_PCLK_DIV4;
  hadc1.Init.Resolution = ADC_RESOLUTION_12B;
  hadc1.Init.ScanConvMode = DISABLE;
  hadc1.Init.ContinuousConvMode = DISABLE;
  hadc1.Init.DiscontinuousConvMode = DISABLE;
  hadc1.Init.ExternalTrigConvEdge = ADC_EXTERNALTRIGCONVEDGE_NONE;
  hadc1.Init.ExternalTrigConv = ADC_SOFTWARE_START;
  hadc1.Init.DataAlign = ADC_DATAALIGN_RIGHT;
  hadc1.Init.NbrOfConversion = 1;
  hadc1.Init.DMAContinuousRequests = DISABLE;
  hadc1.Init.EOCSelection = ADC_EOC_SINGLE_CONV;
  if (HAL_ADC_Init(&hadc1) != HAL_OK)
  {
    Error_Handler();
  }

  /** Configure for the selected ADC regular channel its corresponding rank in the sequencer and its sample time.
  */
  sConfig.Channel = ADC_CHANNEL_0;
  sConfig.Rank = 1;
  sConfig.SamplingTime = ADC_SAMPLETIME_3CYCLES;
  if (HAL_ADC_ConfigChannel(&hadc1, &sConfig) != HAL_OK)
  {
    Error_Handler();
  }

}

static void MX_ADC2_Init(void)
{

  ADC_ChannelConfTypeDef sConfig = {0};

  /** Configure the global features of the ADC (Clock, Resolution, Data Alignment and number of conversion)
  */
  hadc2.Instance = ADC2;
  hadc2.Init.ClockPrescaler = ADC_CLOCK_SYNC_PCLK_DIV4;
  hadc2.Init.Resolution = ADC_RESOLUTION_12B;
  hadc2.Init.ScanConvMode = DISABLE;
  hadc2.Init.ContinuousConvMode = DISABLE;
  hadc2.Init.DiscontinuousConvMode = DISABLE;
  hadc2.Init.ExternalTrigConvEdge = ADC_EXTERNALTRIGCONVEDGE_NONE;
  hadc2.Init.ExternalTrigConv = ADC_SOFTWARE_START;
  hadc2.Init.DataAlign = ADC_DATAALIGN_RIGHT;
  hadc2.Init.NbrOfConversion = 1;
  hadc2.Init.DMAContinuousRequests = DISABLE;
  hadc2.Init.EOCSelection = ADC_EOC_SINGLE_CONV;
  if (HAL_ADC_Init(&hadc2) != HAL_OK)
  {
    Error_Handler();
  }

  /** Configure for the selected ADC regular channel its corresponding rank in the sequencer and its sample time.
  */
  sConfig.Channel = ADC_CHANNEL_0;
  sConfig.Rank = 1;
  sConfig.SamplingTime = ADC_SAMPLETIME_3CYCLES;
  if (HAL_ADC_ConfigChannel(&hadc2, &sConfig) != HAL_OK)
  {
    Error_Handler();
  }

}

static void MX_ADC3_Init(void)
{

  ADC_ChannelConfTypeDef sConfig = {0};

  /** Configure the global features of the ADC (Clock, Resolution, Data Alignment and number of conversion)
  */
  hadc3.Instance = ADC3;
  hadc3.Init.ClockPrescaler = ADC_CLOCK_SYNC_PCLK_DIV4;
  hadc3.Init.Resolution = ADC_RESOLUTION_12B;
  hadc3.Init.ScanConvMode = DISABLE;
  hadc3.Init.ContinuousConvMode = DISABLE;
  hadc3.Init.DiscontinuousConvMode = DISABLE;
  hadc3.Init.ExternalTrigConvEdge = ADC_EXTERNALTRIGCONVEDGE_NONE;
  hadc3.Init.ExternalTrigConv = ADC_SOFTWARE_START;
  hadc3.Init.DataAlign = ADC_DATAALIGN_RIGHT;
  hadc3.Init.NbrOfConversion = 1;
  hadc3.Init.DMAContinuousRequests = DISABLE;
  hadc3.Init.EOCSelection = ADC_EOC_SINGLE_CONV;
  if (HAL_ADC_Init(&hadc3) != HAL_OK)
  {
    Error_Handler();
  }

  /** Configure for the selected ADC regular channel its corresponding rank in the sequencer and its sample time.
  */
  sConfig.Channel = ADC_CHANNEL_0;
  sConfig.Rank = 1;
  sConfig.SamplingTime = ADC_SAMPLETIME_3CYCLES;
  if (HAL_ADC_ConfigChannel(&hadc3, &sConfig) != HAL_OK)
  {
    Error_Handler();
  }

}

static void MX_SPI2_Init(void)
{

  /* SPI2 parameter configuration*/
  hspi2.Instance = SPI2;
  hspi2.Init.Mode = SPI_MODE_MASTER;
  hspi2.Init.Direction = SPI_DIRECTION_2LINES;
  hspi2.Init.DataSize = SPI_DATASIZE_8BIT;
  hspi2.Init.CLKPolarity = SPI_POLARITY_LOW;
  hspi2.Init.CLKPhase = SPI_PHASE_1EDGE;
  hspi2.Init.NSS = SPI_NSS_HARD_OUTPUT;
  hspi2.Init.BaudRatePrescaler = SPI_BAUDRATEPRESCALER_2;
  hspi2.Init.FirstBit = SPI_FIRSTBIT_MSB;
  hspi2.Init.TIMode = SPI_TIMODE_DISABLE;
  hspi2.Init.CRCCalculation = SPI_CRCCALCULATION_DISABLE;
  hspi2.Init.CRCPolynomial = 10;
  if (HAL_SPI_Init(&hspi2) != HAL_OK)
  {
    Error_Handler();
  }

}

static void MX_TIM3_Init(void)
{

  TIM_Encoder_InitTypeDef sConfig = {0};
  TIM_MasterConfigTypeDef sMasterConfig = {0};

  htim3.Instance = TIM3;
  htim3.Init.Prescaler = 0;
  htim3.Init.CounterMode = TIM_COUNTERMODE_UP;
  htim3.Init.Period = 65535;
  htim3.Init.ClockDivision = TIM_CLOCKDIVISION_DIV1;
  htim3.Init.AutoReloadPreload = TIM_AUTORELOAD_PRELOAD_DISABLE;
  sConfig.EncoderMode = TIM_ENCODERMODE_TI1;
  sConfig.IC1Polarity = TIM_ICPOLARITY_RISING;
  sConfig.IC1Selection = TIM_ICSELECTION_DIRECTTI;
  sConfig.IC1Prescaler = TIM_ICPSC_DIV1;
  sConfig.IC1Filter = 0;
  sConfig.IC2Polarity = TIM_ICPOLARITY_RISING;
  sConfig.IC2Selection = TIM_ICSELECTION_DIRECTTI;
  sConfig.IC2Prescaler = TIM_ICPSC_DIV1;
  sConfig.IC2Filter = 0;
  if (HAL_TIM_Encoder_Init(&htim3, &sConfig) != HAL_OK)
  {
    Error_Handler();
  }
  sMasterConfig.MasterOutputTrigger = TIM_TRGO_RESET;
  sMasterConfig.MasterSlaveMode = TIM_MASTERSLAVEMODE_DISABLE;
  if (HAL_TIMEx_MasterConfigSynchronization(&htim3, &sMasterConfig) != HAL_OK)
  {
    Error_Handler();
  }

}

static void MX_TIM11_Init(void)
{

  TIM_OC_InitTypeDef sConfigOC = {0};

  htim11.Instance = TIM11;
  htim11.Init.Prescaler = 1679;
  htim11.Init.CounterMode = TIM_COUNTERMODE_UP;
  htim11.Init.Period = 999;
  htim11.Init.ClockDivision = TIM_CLOCKDIVISION_DIV1;
  htim11.Init.AutoReloadPreload = TIM_AUTORELOAD_PRELOAD_DISABLE;
  if (HAL_TIM_Base_Init(&htim11) != HAL_OK)
  {
    Error_Handler();
  }
  if (HAL_TIM_PWM_Init(&htim11) != HAL_OK)
  {
    Error_Handler();
  }
  sConfigOC.OCMode = TIM_OCMODE_PWM2;
  sConfigOC.Pulse = 300;
  sConfigOC.OCPolarity = TIM_OCPOLARITY_HIGH;
  sConfigOC.OCFastMode = TIM_OCFAST_DISABLE;
  if (HAL_TIM_PWM_ConfigChannel(&htim11, &sConfigOC, TIM_CHANNEL_1) != HAL_OK)
  {
    Error_Handler();
  }
  HAL_TIM_MspPostInit(&htim11);

}

static void MX_USB_OTG_FS_PCD_Init(void)
{

  hpcd_USB_OTG_FS.Instance = USB_OTG_FS;
  hpcd_USB_OTG_FS.Init.dev_endpoints = 4;
  hpcd_USB_OTG_FS.Init.speed = PCD_SPEED_FULL;
  hpcd_USB_OTG_FS.Init.dma_enable = DISABLE;
  hpcd_USB_OTG_FS.Init.phy_itface = PCD_PHY_EMBEDDED;
  hpcd_USB_OTG_FS.Init.Sof_enable = DISABLE;
  hpcd_USB_OTG_FS.Init.low_power_enable = DISABLE;
  hpcd_USB_OTG_FS.Init.lpm_enable = DISABLE;
  hpcd_USB_OTG_FS.Init.vbus_sensing_enable = DISABLE;
  hpcd_USB_OTG_FS.Init.use_dedicated_ep1 = DISABLE;
  if (HAL_PCD_Init(&hpcd_USB_OTG_FS) != HAL_OK)
  {
    Error_Handler();
  }

}

static void MX_GPIO_Init(void)
{
  GPIO_InitTypeDef GPIO_InitStruct = {0};

  /* GPIO Ports Clock Enable */
  __HAL_RCC_GPIOE_CLK_ENABLE();
  __HAL_RCC_GPIOI_CLK_ENABLE();
  __HAL_RCC_GPIOF_CLK_ENABLE();
  __HAL_RCC_GPIOH_CLK_ENABLE();
  __HAL_RCC_GPIOC_CLK_ENABLE();
  __HAL_RCC_GPIOA_CLK_ENABLE();
  __HAL_RCC_GPIOB_CLK_ENABLE();
  __HAL_RCC_GPIOJ_CLK_ENABLE();
  __HAL_RCC_GPIOG_CLK_ENABLE();
  __HAL_RCC_GPIOD_CLK_ENABLE();
  __HAL_RCC_GPIOK_CLK_ENABLE();

  /*Configure GPIO pin Output Level */
  HAL_GPIO_WritePin(GPIOE, FET_EN42_Pin|FET_EN41_Pin|FET_EN40_Pin|FET_EN39_Pin
                          |FET_EN38_Pin|FET_EN4_Pin|FET_EN3_Pin|FET_EN2_Pin
                          |FET_EN1_Pin|FET_EN0_Pin|FET_EN15_Pin|FET_EN14_Pin
                          |FET_EN13_Pin|FET_EN12_Pin|FET_EN48_Pin|FET_EN47_Pin, GPIO_PIN_RESET);

  /*Configure GPIO pin Output Level */
  HAL_GPIO_WritePin(GPIOI, FET_EN37_Pin|FET_EN36_Pin|FET_EN35_Pin|FET_EN34_Pin
                          |FET_EN33_Pin|FET_EN32_Pin|FET_EN7_Pin|FET_EN28_Pin
                          |FET_EN27_Pin|FET_EN26_Pin|FET_EN25_Pin|FET_EN46_Pin
                          |FET_EN45_Pin|FET_EN44_Pin|FET_EN43_Pin, GPIO_PIN_RESET);

  /*Configure GPIO pin Output Level */
  HAL_GPIO_WritePin(GPIOJ, TMUX_INH0_Pin|TMUX_INH1_Pin|TMUX_INH2_Pin|TMUX_INH3_Pin
                          |TMUX_INH4_Pin|TMUX_INH5_Pin|TMUX_INH6_Pin|TMUX_INH7_Pin
                          |TMUX_INH8_Pin|TMUX_INH9_Pin|TMUX_INH10_Pin|TMUX_INH11_Pin
                          |TMUX_INH12_Pin|TMUX_INH13_Pin|TMUX_INH14_Pin|TMUX_INH15_Pin, GPIO_PIN_SET);

  /*Configure GPIO pin Output Level */
  HAL_GPIO_WritePin(GPIOG, FET_EN6_Pin|FET_EN5_Pin|FET_EN19_Pin|FET_EN18_Pin
                          |FET_EN17_Pin|FET_EN16_Pin|FET_EN31_Pin|FET_EN30_Pin
                          |FET_EN29_Pin|FET_EN56_Pin|FET_EN55_Pin|FET_EN54_Pin
                          |FET_EN53_Pin|FET_EN52_Pin|FET_EN51_Pin|FET_EN49_Pin, GPIO_PIN_RESET);

  /*Configure GPIO pin Output Level */
  HAL_GPIO_WritePin(GPIOB, IO1_Pin|IO2_Pin|TFT_RESET_Pin|TFT_DC_Pin
                          |SD_CS_Pin|LED1_Pin|LED2_Pin, GPIO_PIN_RESET);

  /*Configure GPIO pin Output Level */
  HAL_GPIO_WritePin(GPIOH, TMUX_S0_Pin|TMUX_S1_Pin|IMUX_S0_Pin|IMUX_S1_Pin, GPIO_PIN_RESET);

  /*Configure GPIO pin Output Level */
  HAL_GPIO_WritePin(GPIOD, FET_EN11_Pin|FET_EN10_Pin|FET_EN9_Pin|FET_EN8_Pin
                          |FET_EN23_Pin|FET_EN22_Pin|FET_EN21_Pin|FET_EN20_Pin
                          |FET_EN24_Pin|FET_EN63_Pin|FET_EN62_Pin|FET_EN61_Pin
                          |FET_EN60_Pin|FET_EN59_Pin|FET_EN58_Pin|FET_EN57_Pin, GPIO_PIN_RESET);

  /*Configure GPIO pin Output Level */
  HAL_GPIO_WritePin(FET_EN50_GPIO_Port, FET_EN50_Pin, GPIO_PIN_RESET);

  /*Configure GPIO pins : FET_EN42_Pin FET_EN41_Pin FET_EN40_Pin FET_EN39_Pin
                           FET_EN38_Pin FET_EN4_Pin FET_EN3_Pin FET_EN2_Pin
                           FET_EN1_Pin FET_EN0_Pin FET_EN15_Pin FET_EN14_Pin
                           FET_EN13_Pin FET_EN12_Pin FET_EN48_Pin FET_EN47_Pin */
  GPIO_InitStruct.Pin = FET_EN42_Pin|FET_EN41_Pin|FET_EN40_Pin|FET_EN39_Pin
                          |FET_EN38_Pin|FET_EN4_Pin|FET_EN3_Pin|FET_EN2_Pin
                          |FET_EN1_Pin|FET_EN0_Pin|FET_EN15_Pin|FET_EN14_Pin
                          |FET_EN13_Pin|FET_EN12_Pin|FET_EN48_Pin|FET_EN47_Pin;
  GPIO_InitStruct.Mode = GPIO_MODE_OUTPUT_PP;
  GPIO_InitStruct.Pull = GPIO_NOPULL;
  GPIO_InitStruct.Speed = GPIO_SPEED_FREQ_LOW;
  HAL_GPIO_Init(GPIOE, &GPIO_InitStruct);

  /*Configure GPIO pins : FET_EN37_Pin FET_EN36_Pin FET_EN35_Pin FET_EN34_Pin
                           FET_EN33_Pin FET_EN32_Pin FET_EN7_Pin FET_EN28_Pin
                           FET_EN27_Pin FET_EN26_Pin FET_EN25_Pin FET_EN46_Pin
                           FET_EN45_Pin FET_EN44_Pin FET_EN43_Pin */
  GPIO_InitStruct.Pin = FET_EN37_Pin|FET_EN36_Pin|FET_EN35_Pin|FET_EN34_Pin
                          |FET_EN33_Pin|FET_EN32_Pin|FET_EN7_Pin|FET_EN28_Pin
                          |FET_EN27_Pin|FET_EN26_Pin|FET_EN25_Pin|FET_EN46_Pin
                          |FET_EN45_Pin|FET_EN44_Pin|FET_EN43_Pin;
  GPIO_InitStruct.Mode = GPIO_MODE_OUTPUT_PP;
  GPIO_InitStruct.Pull = GPIO_NOPULL;
  GPIO_InitStruct.Speed = GPIO_SPEED_FREQ_LOW;
  HAL_GPIO_Init(GPIOI, &GPIO_InitStruct);

  /*Configure GPIO pins : TMUX_INH0_Pin TMUX_INH1_Pin TMUX_INH2_Pin TMUX_INH3_Pin
                           TMUX_INH4_Pin TMUX_INH5_Pin TMUX_INH6_Pin TMUX_INH7_Pin
                           TMUX_INH8_Pin TMUX_INH9_Pin TMUX_INH10_Pin TMUX_INH11_Pin
                           TMUX_INH12_Pin TMUX_INH13_Pin TMUX_INH14_Pin TMUX_INH15_Pin */
  GPIO_InitStruct.Pin = TMUX_INH0_Pin|TMUX_INH1_Pin|TMUX_INH2_Pin|TMUX_INH3_Pin
                          |TMUX_INH4_Pin|TMUX_INH5_Pin|TMUX_INH6_Pin|TMUX_INH7_Pin
                          |TMUX_INH8_Pin|TMUX_INH9_Pin|TMUX_INH10_Pin|TMUX_INH11_Pin
                          |TMUX_INH12_Pin|TMUX_INH13_Pin|TMUX_INH14_Pin|TMUX_INH15_Pin;
  GPIO_InitStruct.Mode = GPIO_MODE_OUTPUT_PP;
  GPIO_InitStruct.Pull = GPIO_NOPULL;
  GPIO_InitStruct.Speed = GPIO_SPEED_FREQ_LOW;
  HAL_GPIO_Init(GPIOJ, &GPIO_InitStruct);

  /*Configure GPIO pins : FET_EN6_Pin FET_EN5_Pin FET_EN19_Pin FET_EN18_Pin
                           FET_EN17_Pin FET_EN16_Pin FET_EN31_Pin FET_EN30_Pin
                           FET_EN29_Pin FET_EN56_Pin FET_EN55_Pin FET_EN54_Pin
                           FET_EN53_Pin FET_EN52_Pin FET_EN51_Pin FET_EN49_Pin */
  GPIO_InitStruct.Pin = FET_EN6_Pin|FET_EN5_Pin|FET_EN19_Pin|FET_EN18_Pin
                          |FET_EN17_Pin|FET_EN16_Pin|FET_EN31_Pin|FET_EN30_Pin
                          |FET_EN29_Pin|FET_EN56_Pin|FET_EN55_Pin|FET_EN54_Pin
                          |FET_EN53_Pin|FET_EN52_Pin|FET_EN51_Pin|FET_EN49_Pin;
  GPIO_InitStruct.Mode = GPIO_MODE_OUTPUT_PP;
  GPIO_InitStruct.Pull = GPIO_NOPULL;
  GPIO_InitStruct.Speed = GPIO_SPEED_FREQ_LOW;
  HAL_GPIO_Init(GPIOG, &GPIO_InitStruct);

  /*Configure GPIO pins : IO1_Pin IO2_Pin TFT_RESET_Pin TFT_DC_Pin
                           SD_CS_Pin LED1_Pin LED2_Pin */
  GPIO_InitStruct.Pin = IO1_Pin|IO2_Pin|TFT_RESET_Pin|TFT_DC_Pin
                          |SD_CS_Pin|LED1_Pin|LED2_Pin;
  GPIO_InitStruct.Mode = GPIO_MODE_OUTPUT_PP;
  GPIO_InitStruct.Pull = GPIO_NOPULL;
  GPIO_InitStruct.Speed = GPIO_SPEED_FREQ_LOW;
  HAL_GPIO_Init(GPIOB, &GPIO_InitStruct);

  /*Configure GPIO pins : TMUX_S0_Pin TMUX_S1_Pin IMUX_S0_Pin IMUX_S1_Pin */
  GPIO_InitStruct.Pin = TMUX_S0_Pin|TMUX_S1_Pin|IMUX_S0_Pin|IMUX_S1_Pin;
  GPIO_InitStruct.Mode = GPIO_MODE_OUTPUT_PP;
  GPIO_InitStruct.Pull = GPIO_NOPULL;
  GPIO_InitStruct.Speed = GPIO_SPEED_FREQ_LOW;
  HAL_GPIO_Init(GPIOH, &GPIO_InitStruct);

  /*Configure GPIO pins : FET_EN11_Pin FET_EN10_Pin FET_EN9_Pin FET_EN8_Pin
                           FET_EN23_Pin FET_EN22_Pin FET_EN21_Pin FET_EN20_Pin
                           FET_EN24_Pin FET_EN63_Pin FET_EN62_Pin FET_EN61_Pin
                           FET_EN60_Pin FET_EN59_Pin FET_EN58_Pin FET_EN57_Pin */
  GPIO_InitStruct.Pin = FET_EN11_Pin|FET_EN10_Pin|FET_EN9_Pin|FET_EN8_Pin
                          |FET_EN23_Pin|FET_EN22_Pin|FET_EN21_Pin|FET_EN20_Pin
                          |FET_EN24_Pin|FET_EN63_Pin|FET_EN62_Pin|FET_EN61_Pin
                          |FET_EN60_Pin|FET_EN59_Pin|FET_EN58_Pin|FET_EN57_Pin;
  GPIO_InitStruct.Mode = GPIO_MODE_OUTPUT_PP;
  GPIO_InitStruct.Pull = GPIO_NOPULL;
  GPIO_InitStruct.Speed = GPIO_SPEED_FREQ_LOW;
  HAL_GPIO_Init(GPIOD, &GPIO_InitStruct);

  /*Configure GPIO pins : SW1_Pin SW2_Pin SW3_Pin ENC_SW_Pin
                           REVERSE_VOLTAGE_ALERT_Pin */
  GPIO_InitStruct.Pin = SW1_Pin|SW2_Pin|SW3_Pin|ENC_SW_Pin
                          |REVERSE_VOLTAGE_ALERT_Pin;
  GPIO_InitStruct.Mode = GPIO_MODE_INPUT;
  GPIO_InitStruct.Pull = GPIO_NOPULL;
  HAL_GPIO_Init(GPIOC, &GPIO_InitStruct);

  /*Configure GPIO pin : FET_EN50_Pin */
  GPIO_InitStruct.Pin = FET_EN50_Pin;
  GPIO_InitStruct.Mode = GPIO_MODE_OUTPUT_PP;
  GPIO_InitStruct.Pull = GPIO_NOPULL;
  GPIO_InitStruct.Speed = GPIO_SPEED_FREQ_LOW;
  HAL_GPIO_Init(FET_EN50_GPIO_Port, &GPIO_InitStruct);

}

void Error_Handler(void)
{
  __disable_irq();
  while (1)
  {
  }
}
